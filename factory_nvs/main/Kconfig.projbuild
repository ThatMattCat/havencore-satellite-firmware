## factory_nvs/main/Kconfig.projbuild
```kconfig
menu "Example Configuration"

    config ESP_WIFI_SSID
        string "WiFi SSID"
        default ""
        help
            Default SSID written to NVS on first UF2 boot when the key is
            missing. Leave empty — the main app's settings check treats
            empty strings as missing and will re-enter UF2, giving the
            user another chance to set it via CONFIG.INI.
    config ESP_WIFI_PASSWORD
        string "WiFi Password"
        default ""
        help
            Default Wi-Fi PSK written to NVS on first UF2 boot when the
            key is missing. Keep empty; see ESP_WIFI_SSID.
    config HAVENCORE_BASE_URL
        string "HavenCore Base URL"
        default ""
        help
            Default HavenCore agent base URL (e.g. http://selene.example).
            Keep empty; see ESP_WIFI_SSID.

endmenu
```
